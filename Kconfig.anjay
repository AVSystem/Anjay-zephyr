## Kconfig.anjay
```kconfig
# Copyright 2020-2025 AVSystem <avsystem@avsystem.com>
#
# Licensed under the Apache License, Version 2.0 (the "License");
# you may not use this file except in compliance with the License.
# You may obtain a copy of the License at
#
#     http://www.apache.org/licenses/LICENSE-2.0
#
# Unless required by applicable law or agreed to in writing, software
# distributed under the License is distributed on an "AS IS" BASIS,
# WITHOUT WARRANTIES OR CONDITIONS OF ANY KIND, either express or implied.
# See the License for the specific language governing permissions and
# limitations under the License.

menu "Anjay LwM2M library"

config ANJAY
    bool "Anjay LwM2M library support"

if ANJAY

choice ANJAY_COMPAT_SECURITY
    prompt "Enable support for encrypted communication"
    default ANJAY_COMPAT_MBEDTLS if ANJAY_COMPAT_NET
    optional

    config ANJAY_COMPAT_MBEDTLS
        bool "Use the Mbed TLS backend"
        select MBEDTLS
        select MBEDTLS_ENTROPY_ENABLED
        imply MBEDTLS_ENTROPY_C
        imply MBEDTLS_DTLS
        imply MBEDTLS_KEY_EXCHANGE_PSK_ENABLED

    menuconfig ANJAY_COMPAT_ZEPHYR_TLS
        bool "Use Zephyr TLS sockets"
        select MODEM_KEY_MGMT if NRF_MODEM_LIB
        select TLS_CREDENTIALS if (!NRF_MODEM_LIB)
        select NET_SOCKETS_SOCKOPT_TLS if (!NRF_MODEM_LIB)
        imply NET_SOCKETS_ENABLE_DTLS if (!NRF_MODEM_LIB)

        config ANJAY_COMPAT_ZEPHYR_TLS_SESSION_CACHE
            bool "Enable Zephyr TLS session cache."
            default y
            depends on ANJAY_COMPAT_ZEPHYR_TLS

        config ANJAY_COMPAT_ZEPHYR_TLS_SESSION_CACHE_PURGE_ON_START
            bool "Purge modem when Anjay security config is not restored from persistence."
            default y
            depends on ANJAY_COMPAT_ZEPHYR_TLS
            depends on ANJAY_COMPAT_ZEPHYR_TLS_SESSION_CACHE
            depends on NRF_MODEM_LIB
            depends on MODEM_KEY_MGMT
            help
              When reconfiguring Anjay Client, modem can store in cache DTLS Session ID
              valid for a given LwM2M Server, but not for a specific Endpoint, which
              results in hard to debug successful Handshake and rejected registration
              attempts. For production configuration it is advised to disable it for
              data transmitted optimization.

        config ANJAY_COMPAT_ZEPHYR_TLS_EPHEMERAL_SEC_TAG_BASE
            int "Lowest security tag number to use for Anjay's ephemeral credentials"
            default 2652900
            range 0 2147483647
            depends on ANJAY_COMPAT_ZEPHYR_TLS

        config ANJAY_COMPAT_ZEPHYR_TLS_EPHEMERAL_SEC_TAG_COUNT
            int "Numer of security tags to reserve for Anjay's ephemeral credentials"
            default 100
            range 1 2147483647
            depends on ANJAY_COMPAT_ZEPHYR_TLS

        config ANJAY_COMPAT_ZEPHYR_TLS_ASSUME_RESUMPTION_SUCCESS
            bool "Assume that (D)TLS session resumption always succeeds"
            depends on ANJAY_COMPAT_ZEPHYR_TLS
            depends on ANJAY_COMPAT_ZEPHYR_TLS_SESSION_CACHE
            depends on NRF_MODEM_LIB
            default y
            help
              nRF sockets do not provide an API that would allow to check
              whether a full (D)TLS handshake has been performed, or has a
              previously existing session been resumed.

              Enabling this option will prevent the LwM2M Register operation
              from being performed after each handshake; however, if the session
              has indeed not been resumed, messages (notifications, Send
              messages) sent until the device actually re-registers may not be
              properly processed by the LwM2M server.

endchoice

config ANJAY_COMPAT_NET
    bool "Enable Net compatibility implementation"

config ANJAY_COMPAT_NET_LIMITED_POLL_WORKAROUND
    bool "Use alternative implementation of zsock_poll() method called by Anjay's event loop, that enables the use of offloaded socket implementations which offload poll() without support for more than one socket"
    default y if WIFI_ESWIFI
    default n
    depends on ANJAY_COMPAT_NET

config ANJAY_COMPAT_TIME
    bool "Enable Time compatibility implementation"

menuconfig ANJAY_WITH_LOGS
    bool "Enable logging in Anjay, avs_commons and avs_coap."
    default y
    depends on LOG
    help
      If this flag is disabled, no logging is compiled into the binary at all.

    config ANJAY_WITH_TRACE_LOGS
        bool "Enable TRACE-level logs in Anjay, avs_commons and avs_coap."
        default n
        depends on ANJAY_WITH_LOGS

    config ANJAY_WITH_MICRO_LOGS
        bool "Enable the \"micro logs\" feature."
        default n
        help
          Replaces all occurrences of the <c>AVS_DISPOSABLE_LOG()</c> macro with single
          space strings. This is intended to reduce the size of the compiled code, by
          stripping it of almost all log string data.

          Note that this setting will propagate both to avs_commons components
          themselves (as all its internal logs make use of <c>AVS_DISPOSABLE_LOG()</c>)
          and the user code that uses it.
        depends on ANJAY_WITH_LOGS

    module = ANJAY
    module-dep = ANJAY_WITH_LOGS
    module-str = Log level for Anjay
    source "${ZEPHYR_BASE}/subsys/net/Kconfig.template.log_config.net"

config ANJAY_WITH_ACCESS_CONTROL
    bool "Enable core support for Access Control mechanisms."
    default y
    help
      Requires separate implementation of the Access Control object itself.
      Either the implementation available as part of
      ANJAY_WITH_MODULE_ACCESS_CONTROL, or a custom application-provided one
      may be used.

config ANJAY_WITH_DOWNLOADER
    bool "Enable support for the anjay_download() API."
    default y

config ANJAY_WITH_COAP_DOWNLOAD
    bool "Enable support for CoAP(S) downloads."
    default y
    depends on ANJAY_WITH_DOWNLOADER

config ANJAY_WITH_HTTP_DOWNLOAD
    bool "Enable support for HTTP(S) downloads."
    default n
    depends on ANJAY_WITH_DOWNLOADER

config ANJAY_WITH_BOOTSTRAP
    bool "Enable support for the LwM2M Bootstrap Interface."
    default y

config ANJAY_WITH_DISCOVER
    bool "Enable support for the LwM2M Discover operation."
    default y

config ANJAY_WITH_OBSERVE
    bool "Enable support for the LwM2M Information Reporting interface."
    default y
    help
      Information Reporting interface includes Observe and Notify operations

config ANJAY_WITH_OBSERVE_PERSISTENCE
    bool "Enable support for observation persistence"
    default n
    depends on ANJAY_WITH_OBSERVE

config ANJAY_WITH_NET_STATS
    bool "Enable support for measuring amount of LwM2M traffic."
    default y

config ANJAY_WITH_COMMUNICATION_TIMESTAMP_API
    bool "Enable support for communication timestamp API."
    default n
    help
      Enable anjay_get_server_last_registration_time(),
      anjay_get_server_next_update_time() and
      anjay_get_server_last_communication_time() functions.

config ANJAY_WITH_OBSERVATION_STATUS
    bool "Enable support for the anjay_resource_observation_status() API."
    default n

config ANJAY_MAX_OBSERVATION_SERVERS_REPORTED_NUMBER
    int "Maximum number of listed servers that observe a given Resource."
    default 0
    depends on ANJAY_WITH_OBSERVATION_STATUS
    help
      Maximum number of servers observing a given Resource listed by
      anjay_resource_observation_status() function.

config ANJAY_WITH_THREAD_SAFETY
    bool "Enable guarding of all accesses to anjay_t with a mutex."
    default y

config ANJAY_WITH_EVENT_LOOP
    bool "Enable default implementation of the event loop."
    default y

config ANJAY_WITH_LWM2M11
    bool "Enable support for features new to LwM2M protocol version 1.1."
    default n

config ANJAY_WITH_SEND
    bool "Enable support for the LwM2M Send operation."
    default n
    depends on ANJAY_WITH_LWM2M11
    help
      Requires either SENML_JSON or CBOR format to be enabled


config ANJAY_WITH_LEGACY_CONTENT_FORMAT_SUPPORT
    bool "Enable support for legacy CoAP Content-Format values"
    default n
    help
      Enable support for legacy CoAP Content-Format numerical values 1541-1543 that
      have been used before final LwM2M TS 1.0.

config ANJAY_WITH_LWM2M_JSON
    bool "Enable support for JSON format as specified in LwM2M TS 1.0."
    default n

config ANJAY_WITHOUT_TLV
    bool "Disable support for TLV format as specified in LwM2M TS 1.0."
    default n

config ANJAY_WITHOUT_PLAINTEXT
    bool "Disable support for Plain Text format as specified in LwM2M TS 1.0. and 1.1"
    default n

config ANJAY_WITHOUT_DEREGISTER
    bool "Disable use of the Deregister message."
    default n

config ANJAY_WITHOUT_IP_STICKINESS
    bool "Disable support for \"IP stickiness\""
    default y
    help
      "IP stickiness" is a preference of the same IP address when reconnecting to
      a server using a domain name.

config ANJAY_WITH_SENML_JSON
    bool "Enable support for SenML JSON format, as specified in LwM2M TS 1.1."
    default n
    depends on ANJAY_WITH_LWM2M11

config ANJAY_WITH_CBOR
    bool "Enable support for CBOR and SenML CBOR formats, as specified in LwM2M TS 1.1."
    default n
    depends on ANJAY_WITH_LWM2M11


config ANJAY_WITH_CON_ATTR
    bool "Enable support for custom \"con\" attribute that controls Confirmable notifications."
    default n
    depends on ANJAY_WITH_OBSERVE

config ANJAY_MAX_PK_OR_IDENTITY_SIZE
    int "Maximum size of the \"Public Key or Identity\""
    default 256
    help
      Maximum size in bytes supported for the \"Public Key or Identity\" resource
      in the LwM2M Security object.

config ANJAY_MAX_SECRET_KEY_SIZE
    int "Maximum size of the \"Secret Key\""
    default 128
    help
      Maximum size in bytes supported for the \"Secret Key\" resource in the LwM2M
      Security Object.

config ANJAY_MAX_DOUBLE_STRING_SIZE
    int "Maximum length supported for stringified floating-point values."
    default 64
    help
      Used when parsing plaintext and SenML JSON content formats - when parsing a
      floating-point value, any string of length equal or greater than this setting
      will automatically be considered invalid, even if it could in theory be
      parsed as a valid number.

config ANJAY_MAX_URI_SEGMENT_SIZE
    int "Maximum length supported for a single Uri-Path or Location-Path segment."
    default 64
    help
      When handling incoming CoAP messages, any Uri-Path or Location-Path option of
      length equal or greater than this setting will be considered invalid.

config ANJAY_MAX_URI_QUERY_SEGMENT_SIZE
    int "Maximum length supported for a single Uri-Query segment."
    default 64
    help
      When handling incoming CoAP messages, any Uri-Query option of length equal or
      greater than this setting will be considered invalid.

config ANJAY_DTLS_SESSION_BUFFER_SIZE
    int "DTLS buffer size"
    default 1024
    help
      Size of buffer allocated for storing DTLS session state when connection is
      not in use (e.g. during queue mode operation).

config ANJAY_WITH_ATTR_STORAGE
    bool "Enable attr_storage module"
    default y

config ANJAY_WITH_MODULE_ACCESS_CONTROL
    bool "Enable access control module"
    default y
    depends on ANJAY_WITH_ACCESS_CONTROL

config ANJAY_WITH_MODULE_SECURITY
    bool "Enable security module"
    default y

config ANJAY_WITH_MODULE_SERVER
    bool "Enable server module"
    default y

config ANJAY_WITH_MODULE_FW_UPDATE
    bool "Enable fw_update module"
    default y
    depends on ANJAY_WITH_DOWNLOADER

config ANJAY_WITH_MODULE_ADVANCED_FW_UPDATE
    bool "Enable advanced_fw_update module"
    default n
    depends on ANJAY_WITH_DOWNLOADER


config ANJAY_WITH_MODULE_IPSO_OBJECTS
    bool "Enable IPSO objects implementation"
    default y

config ANJAY_WITH_MODULE_IPSO_OBJECTS_V2
    bool "(experimental feature) Enable IPSO V2 objects implementation"
    default n

config ANJAY_WITH_MODULE_FACTORY_PROVISIONING
    bool "Enable factory provisioning module"
    default n
    depends on ANJAY_WITH_CBOR

config ANJAY_MAX_HOLDOFF_TIME
    int "Maximum holdoff time in seconds."
    default 20
    depends on ANJAY_WITH_BOOTSTRAP
endif

endmenu
```
